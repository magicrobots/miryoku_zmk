// Copyright 2022 Manna Harbour
// https://github.com/manna-harbour/miryoku

#include "../miryoku/custom_config.h"
#include "../miryoku/mapping/36/minidox.h"
#include "../miryoku/miryoku.dtsi"

/* Increase mouse speed and responsiveness */
&mmv {
    acceleration-exponent = <1>;      // 1 = linear, 2 = exponential
    time-to-max-speed-ms = <400>;    // How long to reach top speed (lower is faster)
    delay-ms = <0>;                   // Instant start
};

/* These defines must come after the miryoku includes to avoid redefinition errors */
#undef ZMK_POINTING_DEFAULT_MOVE_VAL
#define ZMK_POINTING_DEFAULT_MOVE_VAL 2200
